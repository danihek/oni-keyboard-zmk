## config/Kconfig.defconfig
```kconfig
# Copyright (c) 2022 The ZMK Contributors
# SPDX-License-Identifier: MIT

if SHIELD_SWWEEEP_LEFT

config ZMK_KEYBOARD_NAME
    default "oni-kb"

config ZMK_SPLIT_ROLE_CENTRAL
    default y

config CONFIG_ZMK_SPLIT_BLE_CENTRAL_BATTERY_LEVEL_PROXY
    default y

config CONFIG_ZMK_SPLIT_BLE_CENTRAL_BATTERY_LEVEL_FETCHING
    default y

endif

if SHIELD_SWWEEEP_LEFT || SHIELD_SWWEEEP_RIGHT
config ZMK_SPLIT
    default y
endif
```

## config/boards/shields/oni/Kconfig.defconfig
```kconfig
# Copyright (c) 2022 The ZMK Contributors
# SPDX-License-Identifier: MIT

if SHIELD_ONI_LEFT

config ZMK_KEYBOARD_NAME
    default "oni"

config ZMK_SPLIT_ROLE_CENTRAL
    default y

endif

if SHIELD_ONI_LEFT || SHIELD_ONI_RIGHT
config ZMK_SPLIT
    default y
endif
```

## config/boards/shields/oni/Kconfig.shield
```kconfig
# Copyright (c) 2022 The ZMK Contributors
# SPDX-License-Identifier: MIT

config SHIELD_ONI_LEFT
    def_bool $(shields_list_contains,oni_left)

config SHIELD_ONI_RIGHT
    def_bool $(shields_list_contains,oni_right)
```
